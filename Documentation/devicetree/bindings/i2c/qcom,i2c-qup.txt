## Documentation/devicetree/bindings/i2c/qcom,i2c-qup.txt
```
Qualcomm Universal Peripheral (QUP) I2C controller

Required properties:
 - compatible: Should be:
   * "qcom,i2c-qup-v1.1.1" for 8660, 8960 and 8064.
   * "qcom,i2c-qup-v2.1.1" for 8974 v1.
   * "qcom,i2c-qup-v2.2.1" for 8974 v2 and later.
 - reg: Should contain QUP register address and length.
 - interrupts: Should contain I2C interrupt.

 - clocks: A list of phandles + clock-specifiers, one for each entry in
   clock-names.
 - clock-names: Should contain:
   * "core" for the core clock
   * "iface" for the AHB clock

 - #address-cells: Should be <1> Address cells for i2c device address
 - #size-cells: Should be <0> as i2c addresses have no size component

Optional properties:
 - clock-frequency: Should specify the desired i2c bus clock frequency in Hz,
                    defaults to 100kHz if omitted.
 - qup-clock-frequency: Should specify the desired i2c qup clock frequency in
                    Hz. If omitted, then the frequency configured by bootloader
		    will be used.
 - noise-reject-scl: Should specify the desired scl noise reject value (max value 3)
 - noise-reject-sda: Should specify the desired sda noise reject value (max value 3)
 - duty-cycle: Specify clock dividers for i2c bus duty-cycle.
		Bits 16:8 should have the high timer divider value (min value
		is 7). Bits 7:0 should have the Fast/Standard (FS) divider
		value (min value is 7). Computing the correct divider values
		for a specific duty cycle requires using the clock-frequency
		property above. In other words, do not change clock-frequency
		without recomputing duty-cycle.

Child nodes should conform to i2c bus binding.

Example:

i2c@f9924000 {
	compatible = "qcom,i2c-qup-v2.2.1";
	reg = <0xf9924000 0x1000>;
	interrupts = <0 96 0>;

	clocks = <&gcc GCC_BLSP1_QUP2_I2C_APPS_CLK>, <&gcc GCC_BLSP1_AHB_CLK>;
	clock-names = "core", "iface";

	clock-frequency = <355000>;

	#address-cells = <1>;
	#size-cells = <0>;

	noise-reject-scl = <0x1>;
	noise-reject-sda = <0x1>;
	duty-cycle = <0x5edb>;
};
```

## Documentation/devicetree/bindings/media/mediatek-mdp.txt
```
* Mediatek Media Data Path

Media Data Path is used for scaling and color space conversion.

Required properties:
  - compatible : should contain them as below:
        "mediatek,mt8173-mdp"
        "mediatek,mt8173-mdp-rdma"
        "mediatek,mt8173-mdp-rsz"
        "mediatek,mt8173-mdp-wdma"
        "mediatek,mt8173-mdp-wrot"
  - clocks : device clocks
  - power-domains : a phandle to the power domain.
  - mediatek,larb : should contain the larbes of current platform
  - iommus : Mediatek IOMMU H/W has designed the fixed associations with
        the multimedia H/W. and there is only one multimedia iommu domain.
        "iommus = <&iommu portid>" the "portid" is from
        dt-bindings\iommu\mt8173-iommu-port.h, it means that this portid will
        enable iommu. The portid default is disable iommu if "<&iommu portid>"
        don't be added.
  - mediatek,vpu : the node of video processor unit

Example:
	mdp_rdma0: rdma@14001000 {
		compatible = "mediatek,mt8173-mdp-rdma",
			     "mediatek,mt8173-mdp";
		reg = <0 0x14001000 0 0x1000>;
		clocks = <&mmsys CLK_MM_MDP_RDMA0>,
			 <&mmsys CLK_MM_MUTEX_32K>;
		power-domains = <&scpsys MT8173_POWER_DOMAIN_MM>;
		iommus = <&iommu M4U_PORT_MDP_RDMA0>;
		mediatek,larb = <&larb0>;
		mediatek,vpu = <&vpu>;
	};

	mdp_rdma1: rdma@14002000 {
		compatible = "mediatek,mt8173-mdp-rdma";
		reg = <0 0x14002000 0 0x1000>;
		clocks = <&mmsys CLK_MM_MDP_RDMA1>,
			 <&mmsys CLK_MM_MUTEX_32K>;
		power-domains = <&scpsys MT8173_POWER_DOMAIN_MM>;
		iommus = <&iommu M4U_PORT_MDP_RDMA1>;
		mediatek,larb = <&larb4>;
	};

	mdp_rsz0: rsz@14003000 {
		compatible = "mediatek,mt8173-mdp-rsz";
		reg = <0 0x14003000 0 0x1000>;
		clocks = <&mmsys CLK_MM_MDP_RSZ0>;
		power-domains = <&scpsys MT8173_POWER_DOMAIN_MM>;
	};

	mdp_rsz1: rsz@14004000 {
		compatible = "mediatek,mt8173-mdp-rsz";
		reg = <0 0x14004000 0 0x1000>;
		clocks = <&mmsys CLK_MM_MDP_RSZ1>;
		power-domains = <&scpsys MT8173_POWER_DOMAIN_MM>;
	};

	mdp_rsz2: rsz@14005000 {
		compatible = "mediatek,mt8173-mdp-rsz";
		reg = <0 0x14005000 0 0x1000>;
		clocks = <&mmsys CLK_MM_MDP_RSZ2>;
		power-domains = <&scpsys MT8173_POWER_DOMAIN_MM>;
	};

	mdp_wdma0: wdma@14006000 {
		compatible = "mediatek,mt8173-mdp-wdma";
		reg = <0 0x14006000 0 0x1000>;
		clocks = <&mmsys CLK_MM_MDP_WDMA>;
		power-domains = <&scpsys MT8173_POWER_DOMAIN_MM>;
		iommus = <&iommu M4U_PORT_MDP_WDMA>;
		mediatek,larb = <&larb0>;
	};

	mdp_wrot0: wrot@14007000 {
		compatible = "mediatek,mt8173-mdp-wrot";
		reg = <0 0x14007000 0 0x1000>;
		clocks = <&mmsys CLK_MM_MDP_WROT0>;
		power-domains = <&scpsys MT8173_POWER_DOMAIN_MM>;
		iommus = <&iommu M4U_PORT_MDP_WROT0>;
		mediatek,larb = <&larb0>;
	};

	mdp_wrot1: wrot@14008000 {
		compatible = "mediatek,mt8173-mdp-wrot";
		reg = <0 0x14008000 0 0x1000>;
		clocks = <&mmsys CLK_MM_MDP_WROT1>;
		power-domains = <&scpsys MT8173_POWER_DOMAIN_MM>;
		iommus = <&iommu M4U_PORT_MDP_WROT1>;
		mediatek,larb = <&larb4>;
	};
```

## Documentation/devicetree/bindings/regulator/ipq4019-regulator.txt
```
* Qualcomm Technologies, Inc. IPQ4019 regulators

Required properties:
- compatible		: Must be "regulator-ipq4019".
- states		: Selection of available voltages and corresponding values
- reg			: Register address for controlling LDO
- mask			: Mask value for switching voltages
Example:

	vccq_sd0: regulator@0 {
		compatible = "qcom,regulator-ipq4019";
		regulator-name = "SD0 VccQ";
		regulator-min-microvolt = <1800000>;
		regulator-max-microvolt = <3000000>;
		states = <3000000 0x3
			1800000 0x1>;
		reg = <0x01948000 0x4>;
		mask = <0x3>;
	};
```

## drivers/gpu/drm/bridge/Kconfig
```kconfig
config DRM_GENERIC_GPIO_MUX
	tristate "Generic GPIO-controlled mux"
	depends on DRM
	depends on OF
	select DRM_KMS_HELPER
	---help---
	  This bridge driver models a GPIO-controlled display mux with one
	  input, 2 outputs (e.g. an HDMI mux). The hardware decides which output
	  is active, reports it as a GPIO, and the driver redirects calls to the
	  appropriate downstream bridge (if any).

config DRM_PARADE_PS8640
	tristate "Parade PS8640 MIPI DSI to eDP Converter"
	depends on DRM
	depends on OF
	select DRM_KMS_HELPER
	select DRM_MIPI_DSI
	select DRM_PANEL
	---help---
	  Choose this option if you have PS8640 for display
	  The PS8640 is a high-performance and low-power
	  MIPI DSI to eDP converter

config DRM_PTN3460
	tristate "PTN3460 DP/LVDS bridge"
	depends on DRM
	select DRM_KMS_HELPER
	---help---
	  Parade eDP-LVDS bridge chip driver.

config DRM_ANALOGIX_ANX7688
	tristate "Analogix ANX7688 bridge"
	depends on DRM
	select DRM_KMS_HELPER
	---help---
	  ANX7688 is a transmitter to support DisplayPort over USB-C for
	  smartphone and tablets.
	  This driver only supports the HDMI to DP component of the chip.

config DRM_ANX78XX
	tristate "Analogix ANX78XX bridge"
	select DRM_KMS_HELPER
	select REGMAP_I2C
	---help---
	  ANX78XX is a HD video transmitter chip over micro-USB connector
	  for smartphone device.
```
